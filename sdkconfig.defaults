## sdkconfig.defaults
```kconfig
# WiFi + HTTP server; no Bluetooth needed.
CONFIG_ESP_MAIN_TASK_STACK_SIZE=8192

# The HTTP server task needs a little more room to render pages.
CONFIG_HTTPD_MAX_REQ_HDR_LEN=1024
```
